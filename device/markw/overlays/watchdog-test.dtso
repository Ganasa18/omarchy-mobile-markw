// SPDX-License-Identifier: MIT
/* Safety-only bring-up overlay; see BRINGUP-SUSPEND.md. Never default-on. */
/dts-v1/;
/plugin/;

/ {
	compatible = "xiaomi,markw", "qcom,msm8953";

	fragment@0 {
		target-path = "/soc@0/watchdog@b017000";
		__overlay__ {
			status = "okay";
		};
	};
};
